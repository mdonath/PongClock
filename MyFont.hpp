#ifndef _MyFont_HPP_
#define _MyFont_HPP_

// copied from http://heim.ifi.uio.no/haakoh/avr/a
const int myfont_count = 80;

byte PROGMEM myfont[80][5] = {
  {0, 0, 0, 0, 0}, // space
  {0x3f, 0x48, 0x48, 0x48, 0x3f}, // A
  {0x7f, 0x49, 0x49, 0x49, 0x36},
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  {0x11, 0x13, 0x15, 0x19, 0x11}, // z

  // invader sprites - may still need some tweaking
  {0x0,  0x19, 0x3A, 0x6D, 0x7A}, // top invader left
  {0x7A, 0x6D, 0x3A, 0x19, 0x0} , // top invader right
  {0x0,  0x1A, 0x3D, 0x68, 0x7C}, // top invader left wiggle
  {0x7C, 0x68, 0x3D, 0x1A, 0x0},  // top invader right wiggle
  {0x38, 0xD,  0x5E, 0x36, 0x1C}, // middle invader left
  {0x1C, 0x36, 0x5E, 0xD,  0x38},
  {0xE,  0xC,  0x5E, 0x35, 0x1C}, // middle invader left wiggle
  {0x1C, 0x35, 0x5E, 0xC,  0xE},
  {0x19, 0x39, 0x3A, 0x6C, 0x7A}, // bottom invader left
  {0x7A, 0x6C, 0x3A, 0x39, 0x19},
  {0x18, 0x39, 0x3B, 0x6C, 0x7C}, // bottom invader left wiggle
  {0x7C, 0x6C, 0x3B, 0x39, 0x18},
};

class MyFont : public FixedFont {
  public:
    MyFont();
    byte* getChar(char c);

  private:
    char getIndex(char c);
};

MyFont::MyFont():
  FixedFont(5, 7) {
}

byte* MyFont::getChar(char c) {
  int index = getIndex(c);
  if (index < 0 || index >= myfont_count) {
    return NULL;
  }
  return myfont[index]; 
}

char MyFont::getIndex(char c) {
  if (c >= 'A' && c <= 'Z' ) {
    c &= 0x1F;   // A-Z maps to 1-26
  }
  else if (c >= 'a' && c <= 'z') {
    c = (c - 'a') + 42;   // a-z maps to 42-68
  }
  else if (c >= '0' && c <= '9') {
    c = (c - '0') + 32;
  }
  else if (c == ' ') {
    c = 0; // space
  }
  else if (c == '.') {
    c = 27; // full stop
  }
  else if (c == '\'') {
    c = 28; // single quote mark
  }
  else if (c == ':') {
    c = 29; // colon
  }
  else if (c == '>') {
    c = 30; // clock_mode selector arrow
  }
  else if (c == '-') {
    c = 31; // minus
  }
  return c;
}
#endif
