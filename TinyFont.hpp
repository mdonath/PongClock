#ifndef _TinyFont_HPP_
#define _TinyFont_HPP_

#include "Font.hpp"

const int tinyfont_count = 41;
byte PROGMEM mytinyfont[42][3] = {

  //a-z
  {0, 0, 0}   // space!
  , {0x1F, 0x14, 0x1F}
  , {0x1F, 0x15, 0xA}
  , {0x1F, 0x11, 0x11}
  , {0x1F, 0x11, 0xE}
  , {0x1F, 0x15, 0x11}
  , {0x1F, 0x14, 0x10}
  , {0x1F, 0x11, 0x17}
  , {0x1F, 0x4,  0x1F}
  , {0x11, 0x1F, 0x11}
  , {0x3,  0x1,  0x1F}
  , {0x1F, 0x4,  0x1B}
  , {0x1F, 0x1,  0x1}
  , {0x1F, 0x8,  0x1F}
  , {0x1F, 0x10, 0xF}
  , {0x1F, 0x11, 0x1F}
  , {0x1F, 0x14, 0x1C}
  , {0x1C, 0x14, 0x1F}
  , {0x1F, 0x16, 0x1D}
  , {0x1D, 0x15, 0x17}
  , {0x10, 0x1F, 0x10}
  , {0x1F, 0x1,  0x1F}
  , {0x1E, 0x1,  0x1E}
  , {0x1F, 0x2,  0x1F}
  , {0x1B, 0x4,  0x1B}
  , {0x1C, 0x7,  0x1C}
  , {0x13, 0x15, 0x19}

  , {0x01, 0x00, 0x00} // .
  , {0x18, 0x00, 0x00} // '
  , {0x1D, 0x00, 0x00} // !
  , {0x10, 0x15, 0x1C} // ?

  , {0x1F, 0x11, 0x1F} //0 - 9
  , {0x00, 0x00, 0x1F}
  , {0x17, 0x15, 0x1D}
  , {0x11, 0x15, 0x1F}
  , {0x1C, 0x4,  0x1F}
  , {0x1D, 0x15, 0x17}
  , {0x1F, 0x15, 0x17}
  , {0x10, 0x10, 0x1F}
  , {0x1F, 0x15, 0x1F}
  , {0x1D, 0x15, 0x1F}
};


class TinyFont : public FixedFont {
  public:
    TinyFont();
    byte* getChar(char c);
    
  private:
    char getIndex(char c);
};

TinyFont::TinyFont():
  FixedFont(3, 5) {
}

byte* TinyFont::getChar(char c) {
  int index = getIndex(c);
  if (index < 0 || index >= tinyfont_count) {
    return NULL;
  }
  return mytinyfont[index];
}

char TinyFont::getIndex(char c) {
  if ((c >= 'A' && c <= 'Z') || (c >= 'a' && c <= 'z') ) {
    c &= 0x1F;   // A-Z maps to 1-26
  }
  else if (c >= '0' && c <= '9') {
    c = (c - '0') + 31;
  }
  else if (c == ' ') {
    c = 0; // space
  }
  else if (c == '.') {
    c = 27; // full stop
  }
  else if (c == '\'') {
    c = 28; // single quote mark
  }
  else if (c == '!') {
    c = 29; // single quote mark
  }
  else if (c == '?') {
    c = 30; // single quote mark
  }
  return c;
}
#endif
